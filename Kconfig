## Kconfig
```kconfig
menu "nxp_iot_agent"
    config MCUX_COMPONENT_middleware.nxp_iot_agent.lwip_enet
        bool "Component middleware.nxp_iot_agent.lwip_enet"
    config MCUX_COMPONENT_middleware.nxp_iot_agent.lwip_wifi
        bool "Component middleware.nxp_iot_agent.lwip_wifi"

    config MCUX_COMPONENT_middleware.nxp_iot_agent.sss
        bool "Component middleware.nxp_iot_agent.sss"
        depends on MCUX_HW_BOARD_evkmimxrt1060 || MCUX_HW_BOARD_evkmimxrt1170 || MCUX_HW_BOARD_evkbmimxrt1060 || MCUX_HW_BOARD_evkbmimxrt1170
        select MCUX_COMPONENT_middleware.se_hostlib.commonSe050CloudDemos
        select MCUX_COMPONENT_middleware.se_hostlib.tstutils
    config MCUX_COMPONENT_middleware.nxp_iot_agent.psa
        bool "Component middleware.nxp_iot_agent.psa"
        depends on MCUX_HW_BOARD_rdrw612bga || MCUX_HW_BOARD_frdmrw612
    config MCUX_COMPONENT_middleware.nxp_iot_agent
        bool "Component middleware.nxp_iot_agent"
        depends on MCUX_HW_BOARD_evkmimxrt1060 || MCUX_HW_BOARD_evkmimxrt1170 || MCUX_HW_BOARD_evkbmimxrt1060 || MCUX_HW_BOARD_evkbmimxrt1170 || MCUX_HW_BOARD_rdrw612bga || MCUX_HW_BOARD_frdmrw612
        select MCUX_COMPONENT_middleware.nxp_iot_agent.sss if MCUX_HW_BOARD_evkmimxrt1060 || MCUX_HW_BOARD_evkmimxrt1170 || MCUX_HW_BOARD_evkbmimxrt1060 || MCUX_HW_BOARD_evkbmimxrt1170
        select MCUX_COMPONENT_middleware.nxp_iot_agent.psa if MCUX_HW_BOARD_rdrw612bga || MCUX_HW_BOARD_frdmrw612
    if MCUX_COMPONENT_middleware.nxp_iot_agent
        choice
            prompt "Network backend"
            config MCUX_DEPENDENCY_COMPONENT_middleware.nxp_iot_agent.network_backend.lwip_enet
                bool "lwip_enet"
                select MCUX_COMPONENT_middleware.nxp_iot_agent.lwip_enet
            config MCUX_DEPENDENCY_COMPONENT_middleware.nxp_iot_agent.network_backend.lwip_wifi
                bool "lwip_wifi"
                select MCUX_COMPONENT_middleware.nxp_iot_agent.lwip_wifi
        endchoice
    endif

    config MCUX_COMPONENT_middleware.nxp_iot_agent.mqtt
        bool "Component middleware.nxp_iot_agent.mqtt"
        depends on MCUX_HW_BOARD_rdrw612bga || MCUX_HW_BOARD_frdmrw612 || MCUX_HW_BOARD_mcxn5xxevk || MCUX_HW_BOARD_mcxn9xxevk
    if MCUX_COMPONENT_middleware.nxp_iot_agent.mqtt
        choice
            prompt "Network backend"
            config MCUX_DEPENDENCY_COMPONENT_middleware.nxp_iot_agent.mqtt.network_backend.lwip_enet
                bool "lwip_enet"
                select MCUX_COMPONENT_middleware.nxp_iot_agent.lwip_enet
            config MCUX_DEPENDENCY_COMPONENT_middleware.nxp_iot_agent.mqtt.network_backend.lwip_wifi
                bool "lwip_wifi"
                select MCUX_COMPONENT_middleware.nxp_iot_agent.lwip_wifi
        endchoice
    endif

    config MCUX_COMPONENT_middleware.nxp_iot_agent.claimcode
        bool "Component middleware.nxp_iot_agent.claimcode"
        depends on MCUX_HW_BOARD_rdrw612bga || MCUX_HW_BOARD_frdmrw612
endmenu
```

## zephyr/Kconfig
```kconfig
# Copyright 2024 NXP
# SPDX-License-Identifier: Apache-2.0

config EL2GO_COMMON
    bool "Include EL2GO common configuration"
    help
        Includes the common EL2GO headers and defines in the app.

config EL2GO_AGENT_LIBRARY_SOURCES
    bool "Build EL2GO Agent library sources"
    select EL2GO_COMMON
    depends on BUILD_WITH_TFM && NET_SOCKETS && MBEDTLS && HWINFO
    help
        Include the EdgeLock 2GO agent library sources in the app.

config EL2GO_MQTT_LIBRARY_SOURCES
    bool "Build EL2GO MQTT library sources"
    select EL2GO_COMMON
    depends on BUILD_WITH_TFM && NET_SOCKETS && MBEDTLS && !EL2GO_AGENT_LIBRARY_SOURCES
    help
        Include the EdgeLock 2GO MQTT library sources in the app.

config EL2GO_TFM_LEGACY_CRYPTO_ENABLE
    bool "Enable EL2GO TF-M legacy crypto"
    depends on BUILD_WITH_TFM
    help
        Enables usage of legacy crypto inside TF-M (e.g. SHA-1 hashes) by EL2GO.

config EL2GO_TFM_DATA_IMPORT_REGION
    bool "Configure EL2GO TF-M data import region"
    depends on BUILD_WITH_TFM
    help
        Configure the flash memory region of the EL2GO offline provisioned blobs to be accessible from EL2GO NSPE apps.
```

## zephyr/samples/el2go_agent/sample.yaml
```yaml
sample:
  name: EL2GO Agent
  description: The EdgeLock 2GO agent sample demonstrates how to connect to EdgeLock 2GO and provision secure objects to the chip
tests:
  sample.nxp_iot_agent.el2go_agent:
    tags:
      - el2go
      - trusted-firmware-m
      - net
      - wifi
      - cloud
      - mqtt
    platform_allow:
      - rd_rw612_bga/rw612/ns
      - frdm_rw612/rw612/ns
    harness: console
    harness_config:
      type: one_line
      regex:
        - "Connecting to SSID '(.+)' ..."
```

## zephyr/samples/el2go_claimcode_encryption/Kconfig
```kconfig
# Copyright 2026 NXP
# SPDX-License-Identifier: Apache-2.0

source "Kconfig.zephyr"

config CLAIM_CODE_INFO_ADDRESS
    hex "Claim code address"
    default 0x088A0000
    help
        Address where the claim code blob will be written.
```

## zephyr/samples/el2go_claimcode_encryption/sample.yaml
```yaml
sample:
  name: EL2GO Claimcode Encryption
  description: The EdgeLock 2GO claimcode encryption sample demonstrates how to encrypt a claimcode for onboarding a device with the EdgeLock 2GO cloud service
tests:
  sample.nxp_iot_agent.el2go_claimcode_encryption:
    tags:
      - crypto
      - el2go
      - els_pkc
    platform_allow:
      - frdm_rw612
      - rd_rw612_bga
    harness: console
    harness_config:
      type: multi_line
      regex:
        - "Enabling ELS... done"
        - "claimcode information written to flash at address 0x([0-9a-f]{1,8})"
```

## zephyr/samples/el2go_import_blob/Kconfig
```kconfig
# Copyright 2024-2026 NXP
# SPDX-License-Identifier: Apache-2.0

source "Kconfig.zephyr"

config VALIDATE_PSA_IMPORT_MASTER_KEY
    bool "If the imported blobs should be validated by PSA operations for Master key operations"
    help
        Validate master key imported blob from flash

config VALIDATE_PSA_IMPORT_KEY_PAIR
    bool "Config can be used if the imported blobs need to be validated by KEY pair operations"
    help
        Validate Key pair imported blob from flash

config VALIDATE_PSA_IMPORT_CERT
    bool "Config can be used if the imported blobs need to parse the x509 certificate"
    help
        Validate x509 certificate imported blob from flash, it must have VALIDATE_PSA_IMPORT_KEY_PAIR enabled

config BLOB_AREA
    hex "Area where blobs are located"
    default 0x088B0000
    help
        Locate the Flash area where the blobs are located.

config BLOB_AREA_SIZE
    hex "Size of area where blobs are located"
    default 0x2000
    help
        Define the Flash area size where the blobs are located.
```

## zephyr/samples/el2go_import_blob/sample.yaml
```yaml
sample:
  name: EL2GO Import Blob
  description: The EdgeLock 2GO import blob sample demonstrates how to import and optionally use offline provisioned blobs from flash
tests:
  sample.nxp_iot_agent.el2go_import_blob:
    extra_args:
      - OVERLAY_CONFIG="overlay-el2go-rw61x.conf"
    tags:
      - el2go
      - trusted-firmware-m
    platform_allow:
      - rd_rw612_bga/rw612/ns
      - frdm_rw612/rw612/ns
    harness: console
    harness_config:
      fixture: fixture_el2go
      type: multi_line
      regex:
        - "\\d+ blob\\(s\\) imported from flash successfully"
        - "Validate imported blobs"
        - "Cipher encrypt passed!"
        - "ECC sign passed!"
        - "Certificate in DER format:"
        - "Subject field in certificate is:CN=[^ \\n]+"
        - "Issuer field in certificate is:.*O=NXP"
        - "Public_key:\\s*[0-9A-Fa-f]{50,}"

  sample.nxp_iot_agent.el2go_import_blob_product_based:
    extra_args:
      - OVERLAY_CONFIG="overlay-el2go-rw61x.conf"
    tags:
      - el2go
      - trusted-firmware-m
    platform_allow:
      - rd_rw612_bga/rw612/ns
      - frdm_rw612/rw612/ns
    harness: console
    harness_config:
      fixture: fixture_el2go
      type: multi_line
      regex:
        - "\\d+ blob\\(s\\) imported from flash successfully"
        - "Validate imported blobs"
        - "Cipher encrypt passed!"
        - "ECC sign passed!"
        - "Certificate in DER format:"
        - "Subject field in certificate is:CN=[^ \\n]+"
        - "Issuer field in certificate is:.*O=NXP"
        - "Public_key:\\s*[0-9A-Fa-f]{50,}"
```

## zephyr/samples/el2go_mqtt_demo/sample.yaml
```yaml
sample:
  name: EL2GO MQTT Demo
  description: The EdgeLock 2GO MQTT demo sample demonstrates a connection to AWS or Azure MQTT services with preprovisioned EL2GO objects
tests:
  sample.nxp_iot_agent.el2go_mqtt_demo:
    tags:
      - el2go
      - trusted-firmware-m
      - net
      - wifi
      - cloud
      - mqtt
    platform_allow:
      - rd_rw612_bga/rw612/ns
      - frdm_rw612/rw612/ns
    harness: console
    harness_config:
      type: one_line
      regex:
        - "Connecting to SSID '(.+)' ..."
```

## zephyr/tests/el2go_blob_test/Kconfig
```kconfig
# Copyright 2024 NXP
# SPDX-License-Identifier: Apache-2.0

source "Kconfig.zephyr"

config USE_LEGACY_TESTS
    bool "(Only) run the legacy test suites (Internal, External)"

config RUN_VERIFIED_ONLY
    default y
    bool "Only run testcases that are expected to pass"

config LARGE_BLOBS_ENABLED
    bool "Enable testing of blobs with a key size larger than 2783 bytes"
```

## zephyr/tests/el2go_blob_test/testcase.yaml
```yaml
tests:
  nxp_iot_agent.el2go_blob_test:
    tags:
      - crypto
      - el2go
      - trusted-firmware-m
    platform_allow:
      - rd_rw612_bga/rw612/ns
      - frdm_rw612/rw612/ns
    harness: console
    harness_config:
      type: multi_line
      regex:
        - "\\#\\#\\#\\# Start EL2GO blob tests \\#\\#\\#\\#"
        - "\\#\\#\\#\\# EL2GO blob tests finished \\#\\#\\#\\#"
```
