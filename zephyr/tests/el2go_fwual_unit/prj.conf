## CMakeLists.txt
```
# Copyright 2026 NXP
#
# SPDX-License-Identifier: Apache-2.0
#

cmake_minimum_required(VERSION 3.20.0)
find_package(Zephyr REQUIRED HINTS $ENV{ZEPHYR_BASE})
project(el2go_fwual_unit)

add_compile_definitions(ENABLE_TRACE)

target_sources(app PRIVATE
    ${ZEPHYR_NXP_IOT_AGENT_MODULE_DIR}/tests/unit/framework/test_framework.c
    ${ZEPHYR_NXP_IOT_AGENT_MODULE_DIR}/tests/unit/framework/test_utils.c
    ${ZEPHYR_NXP_IOT_AGENT_MODULE_DIR}/tests/unit/public_fwual/test_fwual_public.c
    ${ZEPHYR_NXP_IOT_AGENT_MODULE_DIR}/tests/unit/internal_fwual/test_fwual_internal.c
    ${ZEPHYR_NXP_IOT_AGENT_MODULE_DIR}/tests/unit/internal_fwual/test_fwual_boot.c
    ${ZEPHYR_NXP_IOT_AGENT_MODULE_DIR}/tests/unit/internal_fwual/test_fwual_errors.c
    ${CMAKE_CURRENT_SOURCE_DIR}/src/ztest_fwual_unit_main.c
    ${ZEPHYR_NXP_IOT_AGENT_MODULE_DIR}/zephyr/tests/common/ztest_bridge.c
    ${CMAKE_CURRENT_SOURCE_DIR}/mocks/fwual_storage_mocks.c
    ${CMAKE_CURRENT_SOURCE_DIR}/mocks/fwual_storage_fault_zephyr.c
    # Real FWUAL backend under test, linked against the RAM fakes above.
    ${ZEPHYR_NXP_IOT_AGENT_MODULE_DIR}/libs/fwual/mcuboot/fwual_mcuboot.c
    # fwual.c supplies weak defaults for the public API not overridden above.
    ${ZEPHYR_NXP_IOT_AGENT_MODULE_DIR}/libs/fwual/fwual.c
    # Real SHA-256/ct-memcmp for fwual_verify_image(), see net_crypto_sha256_psa_shim.c.
    ${CMAKE_CURRENT_SOURCE_DIR}/common/net_crypto_sha256_psa_shim.c
    ${ZEPHYR_NXP_IOT_AGENT_MODULE_DIR}/libs/osal/zephyr/alloc.c
    ${ZEPHYR_NXP_IOT_AGENT_MODULE_DIR}/libs/osal/zephyr/print.c
    ${ZEPHYR_NXP_IOT_AGENT_MODULE_DIR}/libs/osal/zephyr/osal.c
)

zephyr_include_directories(
    ${CMAKE_CURRENT_SOURCE_DIR}/common
    ${ZEPHYR_NXP_IOT_AGENT_MODULE_DIR}/zephyr/tests/common
    ${ZEPHYR_NXP_IOT_AGENT_MODULE_DIR}/tests/unit/framework
    ${CMAKE_CURRENT_SOURCE_DIR}/mocks
    ${ZEPHYR_NXP_IOT_AGENT_MODULE_DIR}/tests/unit/mock
    ${ZEPHYR_NXP_IOT_AGENT_MODULE_DIR}/tests/unit/public_fwual
    ${ZEPHYR_NXP_IOT_AGENT_MODULE_DIR}/tests/unit/internal_fwual
    ${ZEPHYR_NXP_IOT_AGENT_MODULE_DIR}/tests/unit
    ${ZEPHYR_NXP_IOT_AGENT_MODULE_DIR}/include
    ${ZEPHYR_NXP_IOT_AGENT_MODULE_DIR}/priv
    ${ZEPHYR_NXP_IOT_AGENT_MODULE_DIR}/libs/net_crypto
    ${ZEPHYR_NXP_IOT_AGENT_MODULE_DIR}/libs/net_crypto/mbedtls
    ${ZEPHYR_NXP_IOT_AGENT_MODULE_DIR}/libs/net_crypto/mbedtls/compat
    ${ZEPHYR_NXP_IOT_AGENT_MODULE_DIR}/libs/platforms
    ${ZEPHYR_NXP_IOT_AGENT_MODULE_DIR}/libs/fwual/src
    ${ZEPHYR_NXP_IOT_AGENT_MODULE_DIR}/libs/osal/include
)

set_source_files_properties(
    ${ZEPHYR_NXP_IOT_AGENT_MODULE_DIR}/tests/unit/internal_fwual/test_fwual_internal.c
    PROPERTIES COMPILE_DEFINITIONS "register_fwual_tests=register_fwual_internal_tests"
)

# psa-crypto public headers for real SHA-256 in fwual_verify_image().
zephyr_include_directories(
    ${ZEPHYR_BASE}/../modules/crypto/tf-psa-crypto/include
    ${ZEPHYR_BASE}/../modules/crypto/tf-psa-crypto/drivers/builtin/include
    ${ZEPHYR_BASE}/../modules/crypto/mbedtls/include
)

# MCUboot public headers -- fwual_mcuboot.c includes <bootutil/bootutil_public.h> directly.
zephyr_include_directories(
    ${ZEPHYR_MCUBOOT_MODULE_DIR}/boot/bootutil/include
    ${ZEPHYR_MCUBOOT_MODULE_DIR}/boot/zephyr/include
)
```

## Kconfig
```
# Copyright 2026 NXP
# SPDX-License-Identifier: Apache-2.0

source "$(ZEPHYR_NXP_IOT_AGENT_MODULE_DIR)/libs/fwual/mcuboot/Kconfig"

source "Kconfig.zephyr"
```

## prj.conf
```kconfig
# Copyright 2026 NXP
# SPDX-License-Identifier: Apache-2.0

CONFIG_PRINTK=y
CONFIG_ZTEST=y

CONFIG_COMPILER_WARNINGS_AS_ERRORS=n

CONFIG_FWUAL_MCUBOOT_IMAGE_COUNT=1

CONFIG_FLASH=y
CONFIG_FLASH_PAGE_LAYOUT=y
CONFIG_FLASH_SIMULATOR=y

CONFIG_PSA_CRYPTO=y
CONFIG_MBEDTLS=y
CONFIG_MBEDTLS_BUILTIN=y
CONFIG_MBEDTLS_PSA_CRYPTO_C=y
CONFIG_MBEDTLS_ENABLE_HEAP=y
CONFIG_MBEDTLS_HEAP_SIZE=65536

CONFIG_PSA_CRYPTO_ENABLE_ALL=y
CONFIG_PSA_WANT_ALG_SHA_256=y

CONFIG_REQUIRES_FULL_LIBC=y
CONFIG_POSIX_API=y
CONFIG_HEAP_MEM_POOL_SIZE=65536
CONFIG_MAIN_STACK_SIZE=16384
CONFIG_ZTEST_STACK_SIZE=16384
```

## src/ztest_fwual_unit_main.c
```c
/*
 * Copyright 2026 NXP
 *
 * SPDX-License-Identifier: Apache-2.0
 *
 */

#include <zephyr/ztest.h>

#include "test_suites.h"
#include "fwual_storage_mocks.h"
#include "ztest_bridge.h"

void register_fwual_internal_tests(void);

static bool s_boot_suite_done;
static int s_boot_suite_rc;

/* Reset the RAM-backed flash/NVS/MCUboot fakes before every test case. */
static void fwual_unit_before(void *fixture)
{
    ARG_UNUSED(fixture);
    fwual_fake_reset();
}

ZTEST_SUITE(el2go_fwual_unit, NULL, NULL, fwual_unit_before, NULL, NULL);

/*
 * FWUAL keeps its state in statics and fwual_init() is idempotent once it has
 * succeeded. The boot-sequence suite exercises the init error paths and
 * therefore has to run before any other test has initialised the library.
 * Whichever test case ztest picks first runs it, so no test depends on the
 * ZTEST execution order.
 */
static void fwual_run_boot_suite_once(void)
{
    if (!s_boot_suite_done) {
        s_boot_suite_done = true;
        s_boot_suite_rc = el2go_run_suite(register_fwual_boot_tests);
    }
    zassert_ok(s_boot_suite_rc, "FWUAL boot-sequence unit suite reported failures");
}

ZTEST(el2go_fwual_unit, test_fwual_public)
{
    fwual_run_boot_suite_once();
    fwual_fake_reset();
    zassert_ok(el2go_run_suite(register_fwual_tests), "FWUAL public unit suite reported failures");
}

ZTEST(el2go_fwual_unit, test_fwual_internal)
{
    fwual_run_boot_suite_once();
    fwual_fake_reset();
    zassert_ok(el2go_run_suite(register_fwual_internal_tests),
               "FWUAL internal unit suite reported failures");
}

ZTEST(el2go_fwual_unit, test_fwual_errors)
{
    fwual_run_boot_suite_once();
    fwual_fake_reset();
    zassert_ok(el2go_run_suite(register_fwual_error_tests),
               "FWUAL error-path unit suite reported failures");
}
```
