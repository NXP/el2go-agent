## zephyr/tests/el2go_ota_tests/testcase.yaml
```yaml
tests:
  nxp_iot_agent.el2go_ota_tests:
    tags:
      - el2go
      - ota
      - unit
    platform_allow:
      - frdm_rw612
      - rd_rw612_bga
    timeout: 60
    harness: ztest
    harness_config:
      type: multi_line
      regex:
        - "ZTEST: test_run_all_ota_suites PASSED"
```

## zephyr/tests/el2go_ota_unit/testcase.yaml
```yaml
tests:
  nxp_iot_agent.unit_native_sim:
    tags:
      - el2go
      - ota
      - unit
      - native_sim
    platform_allow:
      - native_sim
    timeout: 60
    harness: ztest
```
