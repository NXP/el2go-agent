## zephyr/tests/el2go_fwual_component/testcase.yaml
```yaml
tests:
  nxp_iot_agent.el2go_fwual_component:
    tags:
      - el2go
      - ota
      - fwual
      - component
    platform_allow:
      - native_sim
      - frdm_rw612
      - rd_rw612_bga
    timeout: 180
    harness: ztest
```

## zephyr/tests/el2go_fwual_unit/testcase.yaml
```yaml
tests:
  nxp_iot_agent.el2go_fwual_unit:
    tags:
      - el2go
      - ota
      - fwual
      - unit
    platform_allow:
      - native_sim
    timeout: 60
    harness: ztest
```

## zephyr/tests/el2go_ota_agent_component/testcase.yaml
```yaml
tests:
  nxp_iot_agent.el2go_ota_agent_component:
    tags:
      - el2go
      - ota
      - agent
      - component
    platform_allow:
      - native_sim
    timeout: 180
    harness: ztest
```

## zephyr/tests/el2go_ota_agent_unit/testcase.yaml
```yaml
tests:
  nxp_iot_agent.el2go_ota_agent_unit:
    tags:
      - el2go
      - ota
      - agent
      - unit
    platform_allow:
      - native_sim
    timeout: 60
    harness: ztest
```

## zephyr/tests/el2go_ota_component/testcase.yaml
```yaml
tests:
  nxp_iot_agent.el2go_ota_component:
    tags:
      - el2go
      - ota
      - component
    platform_allow:
      - native_sim
      - frdm_rw612
      - rd_rw612_bga
    timeout: 180
    harness: ztest
```
