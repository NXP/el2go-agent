## zephyr/samples/el2go_claimcode_encryption/Kconfig
```kconfig
# Copyright 2026 NXP
# SPDX-License-Identifier: Apache-2.0

source "Kconfig.zephyr"

config EL2GO_CLAIMCODE_STRING
	string "Claimcode string to encrypt"
	default "insert_claimcode_from_el2go"
	help
	  The plain claimcode string that gets encrypted and written to flash.
	  Must match the string used on the EdgeLock 2GO cloud service.

config EL2GO_CLAIMCODE_USE_SANDBOX
	bool "Use sandbox EL2GO claimcode public key"
	default n
	help
	  Use the sandbox ECDH public key for claimcode encryption instead of
	  the production key. Enable this only for development and testing
	  against the EL2GO sandbox environment.

config EL2GO_CLAIMCODE_BACKEND_ELS_PKC
	bool "Use ELS PKC hardware backend for claimcode encryption"
	default y
	help
	  Enable the ELS PKC (EdgeLock Secure Enclave) hardware crypto backend
	  for claimcode encryption. When disabled, a weak stub returning
	  EL2GO_STATUS_NOT_IMPLEMENTED is used and an alternative backend must
	  be provided by the application.

config CLAIM_CODE_INFO_ADDRESS
	hex "Claim code flash address"
	default 0x088A0000
	help
	  Physical flash address where the encrypted claimcode blob will be written.
	  Must match CONFIG_EL2GO_RTP_CLAIMCODE_FLASH_ADDRESS in the el2go_rtp_agent sample.
```

## zephyr/samples/el2go_csr/sample.yaml
```yaml
sample:
  name: EL2GO CSR
  description: >
    Generates a Certificate Signing Request (CSR) for a device using the
    EdgeLock 2GO service and the ELS PKC hardware crypto driver.
tests:
  sample.nxp_iot_agent.el2go_csr:
    tags:
      - el2go
      - csr
      - els_pkc
    platform_allow:
      - frdm_rw612
      - rd_rw612_bga
    integration_platforms:
      - frdm_rw612
```

## zephyr/samples/el2go_import_blob/Kconfig
```kconfig
# Copyright 2024-2026 NXP
# SPDX-License-Identifier: Apache-2.0

source "Kconfig.zephyr"

config VALIDATE_PSA_IMPORT_MASTER_KEY
	bool "Validate imported AES master key blob via PSA cipher operation"
	help
	  When enabled, the sample calls psa_cipher_encrypt() with the imported
	  AES master key to confirm that the key was provisioned and imported
	  successfully.

config VALIDATE_PSA_IMPORT_KEY_PAIR
	bool "Validate imported ECC key-pair blob via PSA sign operation"
	help
	  When enabled, the sample calls psa_sign_message() with the imported
	  ECC key pair to confirm that the key was provisioned and imported
	  successfully.

config VALIDATE_PSA_IMPORT_CERT
	bool "Validate imported certificate blob by parsing it with mbedTLS"
	depends on VALIDATE_PSA_IMPORT_KEY_PAIR
	select EL2GO_NET_CRYPTO_SOURCES
	help
	  When enabled, the sample exports the certificate blob via
	  psa_export_key() and parses it with mbedTLS to print the subject,
	  issuer, and public key fields.  Requires VALIDATE_PSA_IMPORT_KEY_PAIR.

config BLOB_AREA
	hex "Flash address of the blob area"
	default 0x088B0000
	help
	  Physical address of the flash region where EL2GO provisioned blobs
	  are stored.  Must match the address used during provisioning.

config BLOB_AREA_SIZE
	hex "Size of the blob flash area in bytes"
	default 0x2000
	help
	  Size of the flash region where EL2GO provisioned blobs are stored.
```

## zephyr/samples/el2go_import_blob/sample.yaml
```yaml
sample:
  name: EL2GO Import Blob
  description: >
    The EdgeLock 2GO import blob sample demonstrates how to import and
    optionally validate offline-provisioned blobs from flash using the
    PSA Crypto API.  This flavor uses the ELS PKC hardware crypto driver
    and Zephyr SECURE_STORAGE (ZMS backend) instead of TF-M.
tests:
  sample.nxp_iot_agent.el2go_import_blob:
    extra_args:
      - OVERLAY_CONFIG="overlay-el2go-rw61x.conf"
    tags: [el2go, psa, els_pkc]
    platform_allow: [rd_rw612_bga/rw612, frdm_rw612/rw612]
    harness: console
    harness_config:
      fixture: fixture_el2go
      type: multi_line
      regex:
        - "\\d+ blob\\(s\\) imported from flash successfully"
        - "Validate imported blobs"
        - "Cipher encrypt passed!"
        - "ECC sign passed!"
        - "Certificate in DER format:"
        - "Subject field in certificate is:CN=[^ \\n]+"
        - "Issuer field in certificate is:.*O=NXP"
        - "Public_key:\\s*[0-9A-Fa-f]{50,}"
```

## zephyr/samples/el2go_mqtt_demo/Kconfig
```kconfig
# Copyright 2024-2026 NXP
# SPDX-License-Identifier: Apache-2.0

source "${ZEPHYR_NXP_IOT_AGENT_MODULE_DIR}/zephyr/samples/el2go_rtp_agent/Kconfig"
```

## zephyr/samples/el2go_ota_agent_advanced/Kconfig
```kconfig
# Copyright 2026 NXP
# SPDX-License-Identifier: Apache-2.0

source "Kconfig.zephyr"

menu "EL2GO OTA Agent Advanced"

config EL2GO_OTA_ADV_POLL_INTERVAL_S
    int "Base polling interval (seconds)"
    default 3600
    range 1 86400
    help
      How often the agent checks for updates when no failures have occurred.
      On failure the scheduler backs off exponentially up to
      EL2GO_OTA_ADV_RETRY_MAX_BACKOFF_S.

config EL2GO_OTA_ADV_RETRY_INITIAL_BACKOFF_S
    int "Initial retry backoff (seconds)"
    default 60
    range 1 3600
    help
      Delay before the first retry after a check or download failure.
      Subsequent retries double this value up to the maximum.

config EL2GO_OTA_ADV_RETRY_MAX_BACKOFF_S
    int "Maximum retry backoff (seconds)"
    default 3600
    range 1 3600
    help
      Upper bound on the exponential backoff delay.

config EL2GO_OTA_ADV_DOWNLOAD_MAX_RETRIES
    int "Maximum download retry attempts"
    default 3
    help
      Number of times to retry a failed package download before
      reporting failure and backing off.

config EL2GO_OTA_ADV_REPORT_MAX_RETRIES
    int "Maximum status report retry attempts"
    default 5
    help
      Number of times to retry delivering the update status report
      to the EL2GO server before giving up.

config EL2GO_OTA_ADV_BLACKOUT_START_HOUR
    int "Blackout window start hour (0-23, set equal to END to disable)"
    default 0
    range 0 23
    help
      Hour of day (UTC) at which the blackout window begins.
      Set equal to EL2GO_OTA_ADV_BLACKOUT_END_HOUR to disable.
      Requires a valid time source (SNTP or RTC).

config EL2GO_OTA_ADV_BLACKOUT_END_HOUR
    int "Blackout window end hour (0-23)"
    default 0
    range 0 23
    help
      Hour of day (UTC) at which the blackout window ends (exclusive).
      Wraps midnight if END < START (e.g. 22-04 = 22:00 to 04:00).

config EL2GO_OTA_ADV_DEFER_WINDOW_S
    int "Minimum seconds between update attempts (0 = disabled)"
    default 100
    help
      If non-zero, the agent will not start a new download within this
      many seconds of the previous attempt.

config EL2GO_OTA_ADV_TIME_SYNC_MAX_CYCLES
    int "Maximum time-sync retry cycles before proceeding"
    default 10
    help
      Number of times the advanced OTA agent re-runs el2go_app_time_sync()
      while waiting for a valid time, before proceeding without one.

 config EL2GO_OTA_ADV_TIME_SYNC_RETRY_DELAY_MS
    int "Delay in milliseconds between time-sync retry cycles"
    default 5000
    help
      Time in milliseconds the advanced OTA agent sleeps between successive
      calls to el2go_app_time_sync() while waiting for a valid time.

endmenu
```

## zephyr/samples/el2go_ota_agent_advanced/sample.yaml
```yaml
sample:
  name: EL2GO OTA Agent Advanced
  description: >
    Advanced OTA firmware update agent with exponential backoff retry
    scheduling, polling the EdgeLock 2GO OTA service and applying updates
    via MCUboot on RW61x targets.
tests:
  sample.nxp_iot_agent.el2go_ota_agent_advanced:
    tags:
      - el2go
      - ota
      - mcuboot
    platform_allow:
      - frdm_rw612
      - rd_rw612_bga
    integration_platforms:
      - frdm_rw612
```

## zephyr/samples/el2go_ota_agent_core/Kconfig
```kconfig
# Copyright 2026 NXP
# SPDX-License-Identifier: Apache-2.0

source "Kconfig.zephyr"

menu "EL2GO OTA Agent Core"

config EL2GO_OTA_POLL_INTERVAL_S
    int "Update polling interval (seconds)"
    default 30
    help
      How often the core agent polls the EL2GO OTA server for updates.

config EL2GO_OTA_CORE_REPORT_MAX_RETRIES
    int "Maximum status-report retries"
    default 3
    help
      Number of times the core OTA agent retries el2go_ota_report_pending_status()

endmenu
```

## zephyr/samples/el2go_ota_agent_core/sample.yaml
```yaml
sample:
  name: EL2GO OTA Agent Core
  description: >
    Core OTA firmware update agent that polls the EdgeLock 2GO OTA service
    for updates and applies them via MCUboot on RW61x targets.
tests:
  sample.nxp_iot_agent.el2go_ota_agent_core:
    tags:
      - el2go
      - ota
      - mcuboot
    platform_allow:
      - frdm_rw612
      - rd_rw612_bga
    integration_platforms:
      - frdm_rw612
```

## zephyr/samples/el2go_rtp_agent/Kconfig
```kconfig
# Copyright 2026 NXP
# SPDX-License-Identifier: Apache-2.0

source "Kconfig.zephyr"

# ---------------------------------------------------------------------------
# EdgeLock2GO RTP Agent
# ---------------------------------------------------------------------------
menu "EdgeLock2GO RTP Agent"

config EL2GO_RTP_AGENT
    bool "EdgeLock2GO RTP Agent library sources"
    select HWINFO
    help
      Enables the el2go_rtp_lib and its dependencies (keystores, datastores,
      platforms, net_crypto, protobuf, osal) for Zephyr builds.

config EL2GO_RTP_CLAIMCODE_INJECT
    bool "Enable claimcode injection from flash"
    depends on EL2GO_RTP_AGENT
    help
      Reads a claimcode blob from a fixed flash address and imports it into
      PSA ITS before provisioning.

config EL2GO_RTP_CLAIMCODE_FLASH_ADDRESS
    hex "Flash address of the claimcode blob"
    depends on EL2GO_RTP_CLAIMCODE_INJECT
    default 0x088A0000
    help
      Physical flash address where the claimcode blob is stored.
      Layout: { uint8_t indicator[4]; uint32_t size; uint8_t data[size]; }

config EL2GO_RTP_MQTT_VERIFY
    bool "Enable MQTT connectivity verification after provisioning"
    depends on EL2GO_RTP_AGENT
    select MQTT_LIB
    select MQTT_LIB_CUSTOM_TRANSPORT
    select JSON_LIBRARY
    help
      After provisioning, verifies MQTT connectivity using provisioned
      credentials. At least one MQTT backend (AWS or Azure) must be
      enabled via CONFIG_EL2GO_RTP_MQTT_AWS / CONFIG_EL2GO_RTP_MQTT_AZURE.

config EL2GO_RTP_MQTT_AWS
    bool "Enable AWS IoT Core MQTT verification"
    depends on EL2GO_RTP_MQTT_VERIFY
    help
      Verifies the AWS IoT Core device key and certificate by performing a
      TLS handshake against the configured AWS IoT Core endpoint.

config EL2GO_RTP_MQTT_AWS_KEY_ID
    hex "PSA key ID for the AWS IoT Core device private key"
    depends on EL2GO_RTP_MQTT_AWS
    default 0x83000101
    help
      PSA key store ID of the device private key provisioned by EdgeLock 2GO
      for AWS IoT Core authentication.

config EL2GO_RTP_MQTT_AWS_CERT_ID
    hex "PSA ITS UID for the AWS IoT Core device certificate"
    depends on EL2GO_RTP_MQTT_AWS
    default 0x83000102
    help
      PSA ITS UID of the device certificate provisioned by EdgeLock 2GO
      for AWS IoT Core authentication.

config EL2GO_RTP_MQTT_AZURE
    bool "Enable Azure IoT Hub MQTT verification"
    depends on EL2GO_RTP_MQTT_VERIFY
    help
      Verifies the Azure IoT Hub device key and certificate by performing a
      TLS handshake against the configured Azure IoT Hub or DPS endpoint.

config EL2GO_RTP_MQTT_AZURE_KEY_ID
    hex "PSA key ID for the Azure IoT Hub device private key"
    depends on EL2GO_RTP_MQTT_AZURE
    default 0x83000211
    help
      PSA key store ID of the device private key provisioned by EdgeLock 2GO
      for Azure IoT Hub authentication.

config EL2GO_RTP_MQTT_AZURE_CERT_ID
    hex "PSA ITS UID for the Azure IoT Hub device certificate"
    depends on EL2GO_RTP_MQTT_AZURE
    default 0x83000212
    help
      PSA ITS UID of the device certificate provisioned by EdgeLock 2GO
      for Azure IoT Hub authentication.

config EL2GO_RTP_MQTT_AWS_CLIENT_ID
    string "AWS IoT Core MQTT client ID (optional)"
    depends on EL2GO_RTP_MQTT_AWS
    default ""
    help
      Optional MQTT client ID for the AWS IoT Core connection. If left empty
      the client ID is derived dynamically from the Common Name of the device
      leaf certificate.

config EL2GO_RTP_MQTT_AZURE_REGISTRATION_ID
    string "Azure DPS device registration ID (optional)"
    depends on EL2GO_RTP_MQTT_AZURE
    default ""
    help
      Optional DPS registration ID. If left empty it is derived dynamically
      from the Common Name of the device leaf certificate.

config EL2GO_RTP_EDGELOCK2GO_HOSTNAME
    string "EdgeLock 2GO server hostname"
    depends on EL2GO_RTP_AGENT
    default ""
    help
      The hostname of the EdgeLock 2GO cloud service to connect to during
      provisioning. This value is company-specific and can be found in the
      EdgeLock 2GO portal under company settings.
      Leave empty to fall back to the compile-time default in el2go_rtp_config.h.

config EL2GO_RTP_EDGELOCK2GO_PORT
    int "EdgeLock 2GO server port"
    depends on EL2GO_RTP_AGENT
    default 443
    help
      TCP port number for the EdgeLock 2GO cloud service connection.
      Defaults to 443 (HTTPS/TLS).

config EL2GO_RTP_WHITELISTING
    bool "Enable whitelisting mode"
    depends on EL2GO_RTP_AGENT
    help
      Enables whitelisting-based provisioning flow.

config EL2GO_RTP_PLATFORM_KEY_REGISTRATION
    bool "Register EL2GO connection authentication key at platform init"
    depends on EL2GO_RTP_AGENT && !EL2GO_RTP_PSA_BACKEND_TFM
    default n
    help
      When enabled, el2go_platform_init() registers the EL2GO connection
      authentication key into PSA via the ELS PKC S50 driver. Enable for
      the el2go_rtp_agent on non-TF-M targets only. On TF-M targets the
      weak default no-op is used instead.

config EL2GO_RTP_PSA_BACKEND_TFM
    bool "Use TF-M as PSA backend (future)"
    depends on EL2GO_RTP_AGENT && BUILD_WITH_TFM
    default n
    help
      When enabled, PSA Crypto and ITS are backed by TF-M Secure Partition.
      Currently not enabled -- reserved for future TF-M re-enablement.

config EL2GO_TIME_MEASUREMENT
    bool "Enable EL2GO timing measurements"
    default y
    depends on EL2GO_RTP_AGENT
    help
      Enable performance timing measurements in the EL2GO RTP agent demo.
      Records and prints durations for claimcode injection, provisioning,
      MQTT verification, and the full session.

config EL2GO_RTP_ENABLE_INFO
    bool "Enable EL2GO RTP agent INFO logging"
    default y
    depends on EL2GO_RTP_AGENT

config EL2GO_RTP_ENABLE_WARN
    bool "Enable EL2GO RTP agent WARN logging"
    default y
    depends on EL2GO_RTP_AGENT

config EL2GO_RTP_ENABLE_ERROR
    bool "Enable EL2GO RTP agent ERROR logging"
    default y
    depends on EL2GO_RTP_AGENT

config EL2GO_RTP_ENABLE_DEBUG
    bool "Enable EL2GO RTP agent DEBUG logging"
    default n
    depends on EL2GO_RTP_AGENT

config EL2GO_RTP_ENABLE_TRACE
    bool "Enable EL2GO RTP agent TRACE logging"
    default n
    depends on EL2GO_RTP_AGENT

endmenu # EdgeLock2GO RTP Agent
```

## zephyr/samples/el2go_rtp_agent/sample.yaml
```yaml
sample:
  name: EdgeLock 2GO RTP Agent
  description: >
    Provisions device credentials from the EdgeLock 2GO service using the
    RTP (Remote Trusted Provisioning) agent. Supports PSA Crypto via ELS PKC
    hardware (no TF-M), PSA ITS via Zephyr SECURE_STORAGE+ZMS, and optional
    MQTT connectivity verification after provisioning.
  boards:
    - frdm_rw612
    - rd_rw612_bga
tests:
  sample.el2go_rtp_agent:
    tags:
      - el2go
      - rtp
      - provisioning
    platform_allow:
      - frdm_rw612
      - rd_rw612_bga
    integration_platforms:
      - frdm_rw612
```
