## libs/el2go_ota_lib/Kconfig
```kconfig
# Copyright 2026 NXP
# SPDX-License-Identifier: Apache-2.0

if EL2GO_OTA_LIBRARY_SOURCES

# OTA mTLS credential provider

choice EL2GO_OTA_CRED_PROVIDER
    prompt "OTA mTLS credential provider"
    default EL2GO_OTA_CRED_PSA
    help
      Select the backend that supplies the mTLS client certificate and
      private key used during the OTA TLS handshake.

config EL2GO_OTA_CRED_PSA
    bool "PSA ITS (EdgeLock 2GO)"
    help
      Retrieves the client certificate and key from PSA Internal Trusted
      Storage, provisioned by the EdgeLock 2GO secure element.

endchoice # EL2GO_OTA_CRED_PROVIDER

# OTA message transport backend

choice EL2GO_OTA_TRANSPORT_BACKEND
    prompt "OTA message transport backend"
    default EL2GO_OTA_TRANSPORT_GRPC
    help
      Select the wire protocol used to communicate with the EL2GO OTA
      service.

config EL2GO_OTA_TRANSPORT_GRPC
    bool "gRPC over TLS"
    help
      Uses gRPC framing over a TLS-secured TCP connection to exchange
      OTA request and response protobuf messages with the EL2GO service.

endchoice # EL2GO_OTA_TRANSPORT_BACKEND

config EL2GO_OTA_SERVER_HOST
    string "EL2GO OTA server hostname"
    default ""
    help
      Hostname (or IP address) of the EL2GO OTA server the agent connects
      to over mTLS.

config EL2GO_OTA_SERVER_PORT
    int "EL2GO OTA server port"
    default 50051
    help
      TCP port of the EL2GO OTA server.

config EL2GO_OTA_CLIENT_KEY_OBJECT_ID
    hex "Object id of the provisioned mTLS client private key"
    default 0x3010
    help
      Object id referencing the mTLS client private key that is expected to be
      already provisioned in secure storage on the device. The sample only
      references this id; it never imports or provisions the key.

config EL2GO_OTA_CLIENT_CERT_OBJECT_ID
    hex "Object id of the provisioned mTLS client certificate"
    default 0x3021
    help
      Object id referencing the DER-encoded mTLS client certificate that is
      expected to be already provisioned in secure storage on the device. The
      sample only references this id; it never stores the certificate.

config EL2GO_OTA_DISABLE_MTLS
    bool "Disable mTLS client certificate authentication"
    default n
    help
      When enabled, the OTA agent connects with server-authenticated TLS only.
      Server certificate verification remains mandatory.

endif # EL2GO_OTA_LIBRARY_SOURCES
```

## libs/fwual/mcuboot/Kconfig
```kconfig
# Copyright 2026 NXP
# SPDX-License-Identifier: Apache-2.0

config FWUAL_MCUBOOT_IMAGE_COUNT
    int "Number of MCUboot updateable images"
    default 1
    help
      Number of independently updateable firmware images managed by
      the FWUAL MCUboot backend. Must match MCUboot's
      CONFIG_UPDATEABLE_IMAGE_NUMBER.
```
