## zephyr/Kconfig
```kconfig
# Copyright 2026 NXP
# SPDX-License-Identifier: Apache-2.0

config EL2GO_OTA_FWUAL_LIBRARY_SOURCES
    bool "Include FWUAL (Firmware Update Abstraction Layer) sources"
    help
      Includes the FWUAL sources in the application build.

config EL2GO_NET_CRYPTO_SOURCES
    bool "Include net_crypto mbedTLS abstraction layer sources"
    depends on MBEDTLS
    help
      Includes the net_crypto library (SHA-256, CSR generation, certificate
      operations) in the build. Automatically selected by EL2GO_OTA_LIBRARY_SOURCES.
      Also required by the el2go_csr Zephyr sample.

config EL2GO_OTA_LIBRARY_SOURCES
    bool "Include EL2GO OTA Library sources"
    select EL2GO_NET_CRYPTO_SOURCES
    help
      Includes the EL2GO OTA Library sources in the application build.
      Requires mbedTLS PSA crypto and network sockets -- configure these
      in your application's prj.conf (see samples/el2go_ota_agent_core/prj.conf).

config EL2GO_OTA_SERVER_HOST
    string "EL2GO OTA server hostname"
    depends on EL2GO_OTA_LIBRARY_SOURCES
    default ""
    help
      Hostname (or IP address) of the EL2GO OTA server the agent connects
      to over mTLS.

config EL2GO_OTA_SERVER_PORT
    int "EL2GO OTA server port"
    depends on EL2GO_OTA_LIBRARY_SOURCES
    default 50051
    help
      TCP port of the EL2GO OTA server.

config EL2GO_OTA_CLIENT_KEY_OBJECT_ID
    hex "Object id of the provisioned mTLS client private key"
    depends on EL2GO_OTA_LIBRARY_SOURCES
    default 0x3010
    help
      Object id referencing the mTLS client private key that is expected to be
      already provisioned in secure storage on the device. The sample only
      references this id; it never imports or provisions the key.

config EL2GO_OTA_CLIENT_CERT_OBJECT_ID
    hex "Object id of the provisioned mTLS client certificate"
    depends on EL2GO_OTA_LIBRARY_SOURCES
    default 0x3021
    help
      Object id referencing the DER-encoded mTLS client certificate that is
      expected to be already provisioned in secure storage on the device. The
      sample only references this id; it never stores the certificate.


# ---------------------------------------------------------------------------
# EL2GO OTA Platform backend
# ---------------------------------------------------------------------------
config EL2GO_OTA_PLATFORM_SOURCES
    bool "Include EL2GO OTA platform sources"
    help
      Includes a platform backend that implements el2go_platform_init() and
      el2go_platform_free(). Select the backend that matches your SoC below.

if EL2GO_OTA_PLATFORM_SOURCES

choice EL2GO_OTA_PLATFORM_BACKEND
    prompt "EL2GO OTA platform backend"
    default EL2GO_OTA_PLATFORM_ELS_PKC if SOC_SERIES_RW6XX
    help
      Select the platform crypto backend for the EL2GO OTA library.
      Each backend implements the el2go_platform.h interface for a
      specific SoC family.

config EL2GO_OTA_PLATFORM_ELS_PKC
    bool "ELS PKC (RW61x / RW612)"
    depends on MCUX_ELS_PKC
    help
      Uses the ELS PKC driver backed by the S50 secure enclave.
      Suitable for RW610, RW612 and other RW6xx family SoCs.
      Automatically selected when MCUX_ELS_PKC is available (e.g. SOC_SERIES_RW6XX).
      Requires MCUX_PSA_CRYPTO_DRIVER_ELS_PKC and SECURE_STORAGE -- configure
      these in your application's prj.conf (see samples/el2go_ota_agent_core/prj.conf).

endchoice # EL2GO_OTA_PLATFORM_BACKEND

endif # EL2GO_OTA_PLATFORM_SOURCES

# ---------------------------------------------------------------------------
# Network backend
# ---------------------------------------------------------------------------
config EL2GO_NETWORK_SOURCES
    bool "Include network sources"
    help
      Includes a network backend that implements el2go_app_net_init().
      Select the backend that matches your hardware below.

if EL2GO_NETWORK_SOURCES

choice EL2GO_NETWORK_BACKEND
    prompt "Network backend"
    default EL2GO_NETWORK_BACKEND_WIFI if WIFI
    help
      Select the network backend. Each backend implements the
      el2go_app_net_init() interface for a specific transport type.

config EL2GO_NETWORK_BACKEND_WIFI
    bool "Zephyr WiFi (wpa_supplicant / net_mgmt)"
    depends on WIFI && NET_SOCKETS
    help
      Connects to a WiFi network using Zephyr net_mgmt and waits for a
      DHCP address. Configure the SSID and PSK via
      EL2GO_NET_WIFI_SSID and EL2GO_NET_WIFI_PSK.

endchoice # EL2GO_NETWORK_BACKEND

config EL2GO_NET_WIFI_SSID
    string "WiFi SSID"
    depends on EL2GO_NETWORK_BACKEND_WIFI
    default ""
    help
      SSID of the WiFi network.

config EL2GO_NET_WIFI_PSK
    string "WiFi PSK"
    depends on EL2GO_NETWORK_BACKEND_WIFI
    default ""
    help
      Pre-shared key (passphrase) for the WiFi network. Do not commit
      production credentials.

endif # EL2GO_NETWORK_SOURCES


# ---------------------------------------------------------------------------
# Time backend
# ---------------------------------------------------------------------------
config EL2GO_TIME_SOURCES
    bool "Include time sources"
    help
      Includes a wall-clock time backend that implements time_sync() and
      time_get_hour_of_day(). Select the backend that matches your hardware
      below. Used by the advanced OTA agent for blackout window policy.

if EL2GO_TIME_SOURCES

choice EL2GO_TIME_BACKEND
    prompt "Time backend"
    default EL2GO_TIME_BACKEND_NONE
    help
      Select the wall-clock time backend for the OTA agent application.
      Each backend implements the ota_time.h interface.

config EL2GO_TIME_BACKEND_NONE
    bool "None (weak default, time unknown)"
    help
      No time source. time_get_hour_of_day() returns -1, which causes
      time-dependent policy checks (e.g. blackout windows) to be skipped.

config EL2GO_TIME_BACKEND_SNTP
    bool "Zephyr SNTP (one-shot network query)"
    depends on SNTP && NET_SOCKETS
    help
      Performs a one-shot SNTP query after network_init() and derives the
      current UTC hour from the stored epoch and elapsed uptime.

endchoice # EL2GO_TIME_BACKEND

config EL2GO_TIME_SNTP_SERVER
    string "SNTP server hostname"
    depends on EL2GO_TIME_BACKEND_SNTP
    default "pool.ntp.org"
    help
      Hostname (or IP) of the SNTP server queried at sync time.

config EL2GO_TIME_SNTP_TIMEOUT_MS
    int "SNTP query timeout (milliseconds)"
    depends on EL2GO_TIME_BACKEND_SNTP
    default 5000
    help
      Upper bound on the single blocking SNTP request.

endif # EL2GO_TIME_SOURCES


# ---------------------------------------------------------------------------
# Agent state persistence backend
# ---------------------------------------------------------------------------
config EL2GO_OTA_PERSIST_SOURCES
    bool "Include agent state persistence sources"
    help
      Includes a persistence backend that implements the el2go_ota_persist.h
      interface used by the advanced OTA agent to persist orchestration state
      across reboots and power loss. Select the backend below.

if EL2GO_OTA_PERSIST_SOURCES

choice EL2GO_OTA_PERSIST_BACKEND
    prompt "Agent state persistence backend"
    default EL2GO_OTA_PERSIST_BACKEND_NONE
    help
      Select the persistence backend for the advanced OTA agent state machine.

config EL2GO_OTA_PERSIST_BACKEND_NONE
    bool "None (weak default, RAM-only)"
    help
      No persistent storage. State is kept in RAM only and does not survive a
      reboot or power loss, so resume-on-boot is unavailable.

config EL2GO_OTA_PERSIST_BACKEND_NVS
    bool "Zephyr NVS (dedicated agent_state partition)"
    depends on NVS && FLASH && FLASH_MAP
    help
      Persists the agent state record to a dedicated flash partition labelled
      agent_state_partition in the board DTS / overlay. Enables power-loss-safe
      resume of an interrupted update on the next boot.

endchoice # EL2GO_OTA_PERSIST_BACKEND

endif # EL2GO_OTA_PERSIST_SOURCES

# ---------------------------------------------------------------------------
# System event backend
# ---------------------------------------------------------------------------
config EL2GO_OTA_EVENT_SOURCES
    bool "Include system event sources"
    help
      Includes a system-event backend that implements the el2go_ota_event.h
      interface. Used by the advanced OTA agent to trigger an immediate update
      check when network connectivity becomes available. Select the backend
      below.

if EL2GO_OTA_EVENT_SOURCES

choice EL2GO_OTA_EVENT_BACKEND
    prompt "System event backend"
    default EL2GO_OTA_EVENT_BACKEND_NONE
    help
      Select the system-event backend for the advanced OTA agent.

config EL2GO_OTA_EVENT_BACKEND_NONE
    bool "None (weak default, no events)"
    help
      No system events. The agent relies on its periodic polling interval only.

config EL2GO_OTA_EVENT_BACKEND_NETMGMT
    bool "Zephyr net_mgmt (NET_EVENT_L4_CONNECTED)"
    depends on NET_CONNECTION_MANAGER
    help
      Bridges the Zephyr connection-manager NET_EVENT_L4_CONNECTED event to the
      agent so an update check is triggered as soon as the network is up.

endchoice # EL2GO_OTA_EVENT_BACKEND

endif # EL2GO_OTA_EVENT_SOURCES

# ---------------------------------------------------------------------------
# Logging / diagnostics backend
# ---------------------------------------------------------------------------
config EL2GO_OTA_DIAG_SOURCES
    bool "Include logging / diagnostics sources"
    help
      Includes the hardware-agnostic logging front-end (el2go_ota_diag.h) plus a
      platform backend. The OTA_DIAG_* macros used by the sample applications
      route through this module. Select the backend below.

if EL2GO_OTA_DIAG_SOURCES

choice EL2GO_OTA_DIAG_BACKEND
    prompt "Logging backend"
    default EL2GO_OTA_DIAG_BACKEND_CONSOLE
    help
      Select the logging backend. Every backend mirrors log lines to the
      Zephyr console so the HIL test runner markers are always visible.

config EL2GO_OTA_DIAG_BACKEND_CONSOLE
    bool "Zephyr console (printk only)"
    help
      Writes each formatted log line to the Zephyr console via printk. No
      persistent storage.

config EL2GO_OTA_DIAG_BACKEND_RINGBUF
    bool "Zephyr console + persistent flash ring buffer"
    depends on FLASH && FLASH_MAP
    help
      Mirrors each log line to the Zephyr console and also appends it to a
      circular log on a dedicated flash partition (DT node label log_partition,
      label diag_log). The persistent history survives reboot, power loss and
      firmware rollback and can be replayed with el2go_ota_diag_dump().

endchoice # EL2GO_OTA_DIAG_BACKEND

config EL2GO_OTA_DIAG_MIN_LEVEL
    int "Minimum severity persisted to the ring buffer"
    depends on EL2GO_OTA_DIAG_BACKEND_RINGBUF
    default 0
    range 0 4
    help
      Only log lines with a severity greater than or equal to this value are
      written to the persistent ring buffer (console output is unaffected).
      Levels: 0=INFO, 1=DONE, 2=WARN, 3=FAIL, 4=ERROR. The default of 0
      persists everything.

config EL2GO_OTA_DIAG_DUMP_ON_BOOT
    bool "Replay the persistent diagnostics log at boot"
    depends on EL2GO_OTA_DIAG_BACKEND_RINGBUF
    default n
    help
      When enabled, el2go_ota_diag_dump() replays the records persisted before
      the last reboot / rollback to the console early during startup. Intended
      for post-mortem debugging; leave disabled for normal operation so the
      boot output is not cluttered. The persistent history is still recorded
      regardless of this option and can be dumped on demand.

endif # EL2GO_OTA_DIAG_SOURCES

# ---------------------------------------------------------------------------
# System services backend (reboot / sleep / uptime / wait / signal)
# ---------------------------------------------------------------------------
config EL2GO_SYSTEM_SOURCES
    bool "Include system services sources"
    help
      Includes a system-services backend that implements the el2go_app_sys.h
      interface (reboot, blocking sleep, uptime and interruptible wait/signal)
      used by the sample agents. The agents are single-threaded and run on the
      main thread; size the main stack via CONFIG_MAIN_STACK_SIZE (the mTLS
      handshake buffers require a large stack, e.g. 96 KB). Select the backend
      below.


config EL2GO_OTA_TESTS
    bool "Include EL2GO OTA unit test sources"
    help
      Includes the OTA unit test sources in the Zephyr test build.

config EL2GO_OTA_CHUNK_SIZE
    int "OTA download chunk size in bytes"
    depends on EL2GO_OTA_LIBRARY_SOURCES
    default 4096
    help
      Size of each firmware chunk requested from the EL2GO OTA backend.
      Must be a multiple of the FWUAL write alignment (4 bytes for RW612).
      Increasing this value reduces round-trips but increases stack usage
      in the download engine (wire buffer = EL2GO_OTA_CHUNK_SIZE + 256).

config EL2GO_OTA_STATUS_NVS_PARTITION
    string "Flash partition label for OTA status NVS"
    depends on EL2GO_OTA_LIBRARY_SOURCES
    default "ota_status"
    help
      Label of the flash partition used by the OTA status reporting module
      to persist pending status reports across reboots.

config EL2GO_OTA_STATUS_NVS_SECTOR_SIZE
    int "NVS sector size for OTA status storage (bytes)"
    depends on EL2GO_OTA_LIBRARY_SOURCES
    default 4096

config EL2GO_OTA_STATUS_NVS_SECTOR_COUNT
    int "Number of NVS sectors for OTA status storage"
    depends on EL2GO_OTA_LIBRARY_SOURCES
    default 2

# ---------------------------------------------------------------------------
# EdgeLock2GO RTP Agent
# ---------------------------------------------------------------------------
menu "EdgeLock2GO RTP Agent"

config EL2GO_RTP_AGENT
    bool "EdgeLock2GO RTP Agent library sources"
    select HWINFO
    help
      Enables the el2go_rtp_lib and its dependencies (keystores, datastores,
      platforms, net_crypto, protobuf, osal) for Zephyr builds.

config EL2GO_RTP_CLAIMCODE_INJECT
    bool "Enable claimcode injection from flash"
    depends on EL2GO_RTP_AGENT
    help
      Reads a claimcode blob from a fixed flash address and imports it into
      PSA ITS before provisioning.

config EL2GO_RTP_CLAIMCODE_FLASH_ADDRESS
    hex "Flash address of the claimcode blob"
    depends on EL2GO_RTP_CLAIMCODE_INJECT
    default 0x088A0000
    help
      Physical flash address where the claimcode blob is stored.
      Layout: { uint8_t indicator[4]; uint32_t size; uint8_t data[size]; }

config EL2GO_RTP_MQTT_VERIFY
    bool "Enable MQTT connectivity verification after provisioning"
    depends on EL2GO_RTP_AGENT
    select MQTT_LIB
    select MQTT_LIB_CUSTOM_TRANSPORT
    select JSON_LIBRARY
    help
      After provisioning, verifies MQTT connectivity using provisioned
      credentials. At least one MQTT backend (AWS or Azure) must be
      enabled via CONFIG_EL2GO_RTP_MQTT_AWS / CONFIG_EL2GO_RTP_MQTT_AZURE.

config EL2GO_RTP_MQTT_AWS
    bool "Enable AWS IoT Core MQTT verification"
    depends on EL2GO_RTP_MQTT_VERIFY
    help
      Verifies the AWS IoT Core device key (PSA key ID 0x4000) and
      certificate (PSA ITS UID 0x4001) by performing a TLS handshake
      against the configured AWS IoT Core endpoint.

config EL2GO_RTP_MQTT_AWS_HOSTNAME
    string "AWS IoT Core endpoint hostname"
    depends on EL2GO_RTP_MQTT_AWS
    default "aw9969rp3sm22-ats.iot.eu-central-1.amazonaws.com"
    help
      The AWS IoT Core device endpoint hostname, e.g.
      "<account-id>-ats.iot.<region>.amazonaws.com".

config EL2GO_RTP_MQTT_AWS_KEY_ID
    hex "PSA key ID for the AWS IoT Core device private key"
    depends on EL2GO_RTP_MQTT_AWS
    default 0x83000101
    help
      PSA key store ID of the device private key provisioned by EdgeLock 2GO
      for AWS IoT Core authentication. Must match the key object ID configured
      in the EL2GO service template (AWS_SERVICE_KEY_PAIR_ID in the old repo).

config EL2GO_RTP_MQTT_AWS_CERT_ID
    hex "PSA ITS UID for the AWS IoT Core device certificate"
    depends on EL2GO_RTP_MQTT_AWS
    default 0x83000102
    help
      PSA ITS UID of the device certificate provisioned by EdgeLock 2GO
      for AWS IoT Core authentication. Must match the cert object ID configured
      in the EL2GO service template (AWS_SERVICE_DEVICE_CERT_ID in the old repo).

config EL2GO_RTP_MQTT_AZURE
    bool "Enable Azure IoT Hub MQTT verification"
    depends on EL2GO_RTP_MQTT_VERIFY
    help
      Verifies the Azure IoT Hub device key and certificate by performing a
      TLS handshake against the configured Azure IoT Hub or DPS endpoint.

config EL2GO_RTP_MQTT_AZURE_HOSTNAME
    string "Azure IoT Hub / DPS hostname"
    depends on EL2GO_RTP_MQTT_AZURE
    default "global.azure-devices-provisioning.net"
    help
      The Azure IoT Hub or DPS hostname for MQTT TLS verification.

config EL2GO_RTP_MQTT_AZURE_KEY_ID
    hex "PSA key ID for the Azure IoT Hub device private key"
    depends on EL2GO_RTP_MQTT_AZURE
    default 0x83000211
    help
      PSA key store ID of the device private key provisioned by EdgeLock 2GO
      for Azure IoT Hub authentication. Must match the key object ID configured
      in the EL2GO service template (AZURE_SERVICE_KEY_PAIR_ID in the old repo).

config EL2GO_RTP_MQTT_AZURE_CERT_ID
    hex "PSA ITS UID for the Azure IoT Hub device certificate"
    depends on EL2GO_RTP_MQTT_AZURE
    default 0x83000212
    help
      PSA ITS UID of the device certificate provisioned by EdgeLock 2GO
      for Azure IoT Hub authentication. Must match the cert object ID configured
      in the EL2GO service template (AZURE_SERVICE_DEVICE_CERT_ID in the old repo).

config EL2GO_RTP_MQTT_AZURE_ID_SCOPE
    string "Azure DPS ID scope"
    depends on EL2GO_RTP_MQTT_AZURE
    default "0ne004510C6"
    help
      The ID scope assigned to the Azure Device Provisioning Service (DPS)
      account, e.g. "0ne004510C6". Corresponds to AZURE_ID_SCOPE in the
      old iot_agent_demo_config.h. Required when connecting to Azure DPS.

config EL2GO_RTP_MQTT_AWS_CLIENT_ID
    string "AWS IoT Core MQTT client ID (optional)"
    depends on EL2GO_RTP_MQTT_AWS
    default ""
    help
      Optional MQTT client ID for the AWS IoT Core connection. If left empty
      the client ID is derived dynamically from the Common Name of the device
      leaf certificate. Corresponds to AWS_CLIENT_ID in the old
      iot_agent_demo_config.h.

config EL2GO_RTP_MQTT_AZURE_REGISTRATION_ID
    string "Azure DPS device registration ID (optional)"
    depends on EL2GO_RTP_MQTT_AZURE
    default ""
    help
      Optional DPS registration ID. If left empty it is derived dynamically
      from the Common Name of the device leaf certificate. Corresponds to
      AZURE_REGISTRATION_ID in the old iot_agent_demo_config.h.

config EL2GO_RTP_EDGELOCK2GO_HOSTNAME
    string "EdgeLock 2GO server hostname"
    depends on EL2GO_RTP_AGENT
    default ""
    help
      The hostname of the EdgeLock 2GO cloud service to connect to during
      provisioning. This value is company-specific and can be found in the
      EdgeLock 2GO portal under company settings.
      Leave empty to fall back to the compile-time default in el2go_rtp_config.h.

config EL2GO_RTP_EDGELOCK2GO_PORT
    int "EdgeLock 2GO server port"
    depends on EL2GO_RTP_AGENT
    default 443
    help
      TCP port number for the EdgeLock 2GO cloud service connection.
      Defaults to 443 (HTTPS/TLS).

config EL2GO_RTP_WHITELISTING
    bool "Enable whitelisting mode"
    depends on EL2GO_RTP_AGENT
    help
      Enables whitelisting-based provisioning flow.

config EL2GO_RTP_PSA_BACKEND_TFM
    bool "Use TF-M as PSA backend (future)"
    depends on EL2GO_RTP_AGENT && BUILD_WITH_TFM
    default n
    help
      When enabled, PSA Crypto and ITS are backed by TF-M Secure Partition.
      Requires tfm_ns_interface_init() at startup.
      Currently not enabled -- reserved for future TF-M re-enablement.

endmenu # EdgeLock2GO RTP Agent

# ---------------------------------------------------------------------------
# Network backend (shared between OTA and RTP samples)
# ---------------------------------------------------------------------------
config EL2GO_OTA_NETWORK_BACKEND_ZEPHYR_WIFI
    bool "Zephyr WiFi network backend"
    depends on WIFI
    help
      Enables the Zephyr WiFi network backend that connects to an AP and
      waits for DHCP before returning from el2go_ota_net_init().

config EL2GO_NET_WIFI_SSID
    string "WiFi SSID"
    depends on EL2GO_OTA_NETWORK_BACKEND_ZEPHYR_WIFI
    default "your_ssid"
    help
      SSID of the WiFi access point to connect to.

config EL2GO_NET_WIFI_PSK
    string "WiFi pre-shared key (password)"
    depends on EL2GO_OTA_NETWORK_BACKEND_ZEPHYR_WIFI
    default "your_password"
    help
      Password (pre-shared key) for the WiFi access point.

if EL2GO_OTA_FWUAL_LIBRARY_SOURCES && BOOTLOADER_MCUBOOT
source "${ZEPHYR_NXP_IOT_AGENT_MODULE_DIR}/libs/fwual/mcuboot/Kconfig"
endif

source "${ZEPHYR_NXP_IOT_AGENT_MODULE_DIR}/libs/el2go_ota_lib/Kconfig"
```
